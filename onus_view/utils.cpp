#include "utils.h"
// define oled display 
#define SCREEN_WIDTH 128
#define SCREEN_HEIGHT 64
#define OLED_RESET     -1
#define bitmap_height   64
#define bitmap_width    64
static const unsigned char PROGMEM bitmap[] = {
  0x00, 0x00, 0x00, 0x00, 0x00, 0x00, 0x00, 0x00, 
  0x00, 0x00, 0x00, 0x00, 0x00, 0x00, 0x00, 0x00, 
  0x00, 0x00, 0x00, 0x00, 0x00, 0x00, 0x00, 0x00, 
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  0x00, 0x00, 0x00, 0x00, 0x00, 0x00, 0x00, 0x00
};
// init ws and oled
WebSocketsClient webSocket;
ESP8266WebServer server(80);
Config config;
Adafruit_SSD1306 display(SCREEN_WIDTH, SCREEN_HEIGHT, &Wire, OLED_RESET);

void loadConfig() {
  EEPROM.get(0, config);
  if (String(config.ssid) != "") {
    WiFi.begin(config.ssid, config.password);
    connectToWiFi();
  }
}

void saveConfig() {
  EEPROM.put(0, config);
  EEPROM.commit();
}

void connectToWiFi() {
  int attempts = 0;
  while (WiFi.status() != WL_CONNECTED && attempts < 20) {
    delay(500);
    Serial.print(".");
    attempts++;
  }
  
  if (WiFi.status() == WL_CONNECTED) {
    setupWebSocket();
  }
}

void setupWebSocket() {
  const char* wsHost = "stream-pro.goonus.io";
  const int wsPort = 443;
  const char* wsPath = "/perpetual/ws";

  webSocket.beginSSL(wsHost, wsPort, wsPath);
  webSocket.onEvent(webSocketEvent);
  webSocket.setReconnectInterval(5000);
}
// webserver interface
void handleRoot() {
String html = "<html><head>"
              "<style>"
              "body {"
              "  font-family: Arial, sans-serif;"
              "  background-color: #f4f4f4;"
              "  margin: 0;"
              "  padding: 0;"
              "}"
              "h1 {"
              "  color: #333;"
              "  text-align: center;"
              "  padding: 20px 0;"
              "}"
              "form {"
              "  max-width: 400px;"
              "  margin: 50px auto;"
              "  padding: 20px;"
              "  background-color: #fff;"
              "  box-shadow: 0 4px 8px rgba(0, 0, 0, 0.1);"
              "  border-radius: 10px;"
              "}"
              "input[type='text'], input[type='password'] {"
              "  width: 100%;"
              "  padding: 10px;"
              "  margin: 10px 0 20px;"
              "  border: 1px solid #ccc;"
              "  border-radius: 5px;"
              "  box-sizing: border-box;"
              "}"
              "input[type='submit'] {"
              "  width: 100%;"
              "  padding: 10px;"
              "  background-color: #4CAF50;"
              "  color: white;"
              "  border: none;"
              "  border-radius: 5px;"
              "  cursor: pointer;"
              "  font-size: 16px;"
              "}"
              "input[type='submit']:hover {"
              "  background-color: #45a049;"
              "}"
              "</style>"
              "</head>"
              "<body>"
              "<h1>ESP8266 Configuration</h1>"
              "<form action='/save' method='post'>"
              "SSID: <input type='text' name='ssid' value='" + String(config.ssid) + "'><br>"
              "Password: <input type='password' name='password'><br>"
              "Coin name <input type='text' name='wsParam' value='" + String(config.wsParam) + "'><br>"
              "<input type='submit' value='Save'>"
              "</form></body></html>";
server.send(200, "text/html", html);

}
String formatNumberWithDecimal(String numberStr) {
  String result = "";
  String integerPart = "";
  String decimalPart = "";
  int dotIndex = numberStr.indexOf('.');
  
  if (dotIndex != -1) {
    integerPart = numberStr.substring(0, dotIndex);
    decimalPart = numberStr.substring(dotIndex);
  } else {
    integerPart = numberStr;
  }
  int count = 0;
  for (int i = integerPart.length() - 1; i >= 0; i--) {
    char c = integerPart[i];
    result = c + result;
    count++;
    if (count % 3 == 0 && i > 0 && integerPart[i-1] != '-') {
      result = "," + result;
    }
  }

  result += decimalPart;

  return result;
}
void handleSave() {
  strncpy(config.ssid, server.arg("ssid").c_str(), sizeof(config.ssid));
  strncpy(config.password, server.arg("password").c_str(), sizeof(config.password));
  strncpy(config.wsParam, server.arg("wsParam").c_str(), sizeof(config.wsParam));
  
  saveConfig();
  
  server.send(200, "text/html", "Configuration saved. ESP8266 will restart.");
  delay(1000);
  ESP.restart();
}

void webSocketEvent(WStype_t type, uint8_t * payload, size_t length) {
  switch(type) {
    case WStype_CONNECTED:
      {
        Serial.println("WebSocket connected");
        display.clearDisplay();
        display.setCursor(0, 0);
        display.println("WS connected");
        display.println("Subscribing...");
        display.display();
        
        // Subscribe to the coin name channel
        String subscribeMsg = "{\"method\":\"SUBSCRIBE\",\"params\":[\""+String(config.wsParam)+"@kline_1m\"],\"id\":1}";
        webSocket.sendTXT(subscribeMsg);
      }
      break;
    
    case WStype_TEXT:
      {
        DynamicJsonDocument doc(1024);
        DeserializationError error = deserializeJson(doc, payload, length);
        
        if (error) {
          Serial.print("deserializeJson() failed: ");
          Serial.println(error.c_str());
          return;
        }
        // split data
        String symbol = doc["s"].as<String>();
        String closePrice = doc["D"]["c"].as<String>();
        // display data
        display.clearDisplay();
        display.drawBitmap(-12, 0, bitmap, bitmap_height, bitmap_width, WHITE);
        display.setCursor(45, 20);
        display.println(symbol);
        display.setCursor(45, 35);
        display.println(formatNumberWithDecimal(closePrice));
        display.display();
        Serial.println("Received: " + String((char*)payload));
      }
      break;
  }
}
